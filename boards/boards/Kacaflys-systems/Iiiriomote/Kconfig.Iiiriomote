## boards/boards/Kacaflys-systems/Iiiriomote/Kconfig.Iiiriomote
```kconfig
config BOARD_IIIRIOMOTE
	select SOC_NRF54L15_CPUAPP if BOARD_IIIRIOMOTE_NRF54L15_CPUAPP
	select SOC_NRF54L15_CPUFLPR if \
		BOARD_IIIRIOMOTE_NRF54L15_CPUFLPR || \
		BOARD_IIIRIOMOTE_NRF54L15_CPUFLPR_XIP
```

## boards/boards/Kacaflys-systems/Iiiriomote/Kconfig.defconfig
```kconfig
if CONFIG_SOC_NRF54L15_CPUAPP

config HW_STACK_PROTECTION
	default ARCH_HAS_STACK_PROTECTION

endif # CONFIG_SOC_NRF54L15_CPUAPP
```

## boards/boards/Kacaflys-systems/Iiiriomote/board.yml
```yaml
board:
  name: Iiiriomote
  full_name: Iiiriomote
  vendor: Kacaflys-systems
  socs:
  - name: nrf54l15
    variants:
    - name: xip
      cpucluster: cpuflpr
runners:
  run_once:
    '--recover':
      - runners:
          - nrfjprog
          - nrfutil
        run: first
        groups:
          - boards:
              - Iiiriomote/nrf54l15/cpuapp
              - Iiiriomote/nrf54l15/cpuflpr
              - Iiiriomote/nrf54l15/cpuflpr/xip
    '--erase':
      - runners:
          - nrfjprog
          - jlink
          - nrfutil
        run: first
        groups:
          - boards:
              - Iiiriomote/nrf54l15/cpuapp
              - Iiiriomote/nrf54l15/cpuflpr
              - Iiiriomote/nrf54l15/cpuflpr/xip
    '--reset':
      - runners:
          - nrfjprog
          - jlink
          - nrfutil
        run: last
        groups:
          - boards:
              - Iiiriomote/nrf54l15/cpuapp
              - Iiiriomote/nrf54l15/cpuflpr
              - Iiiriomote/nrf54l15/cpuflpr/xip
```
